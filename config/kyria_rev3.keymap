// vim: ft=c

#include "key-labels/50.h"

// map kyrias extra keys
#define X_L_BM1 ___
#define X_L_BM2 ___
#define X_R_BM1 ___
#define X_R_BM2 ___
#define X_L_TL &kp LALT
#define X_L_TR &mo L_MEDIA
#define X_R_TL &mo L_FN
#define X_R_TR &kp LS(LC(LALT))

// enable rgb
#define ENABLE_RGB_KEYS

// enable bluetooth
#define ENABLE_BT_KEYS

// enable encoders
#define ENABLE_ENCODERS

&led_strip {
  chain-length = <31>; // bith per-key and underglow LEDs
};

&nice_view_spi {
    cs-gpios = <&gpio1 1 GPIO_ACTIVE_HIGH>; // gpio1 is pin P1.01 (101) on the nice!nano v2
};

#include "../tastetrond/tastetrond.keymap"
